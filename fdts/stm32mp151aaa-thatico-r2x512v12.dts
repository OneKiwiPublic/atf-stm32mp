// SPDX-License-Identifier: (GPL-2.0+ OR BSD-3-Clause)
/*
 * Copyright (C) STMicroelectronics 2019 - All Rights Reserved
 * Author: Alexandre Torgue <alexandre.torgue@st.com> for STMicroelectronics.
 */

/dts-v1/;

#include "stm32mp151.dtsi"
#include "stm32mp15xa.dtsi"
#include "stm32mp15-pinctrl.dtsi"
#include "stm32mp15xxaa-pinctrl.dtsi"
#include "stm32mp151aaa-thatico-r2x512v12-pin.dtsi"
#include "stm32mp151aaa-thatico-r2x512v12.dtsi"

/ {
	model = "THATICO STM32MP151AAA3 1GB V1.2 Board";
	compatible = "st,stm32mp151aaa-thatico-r2x512v12", "st,stm32mp151";

	aliases {
		serial0 = &uart4;
		serial1 = &usart3;
		serial2 = &usart2;
	};

	chosen {
		stdout-path = "serial0:115200n8";
	};
};
