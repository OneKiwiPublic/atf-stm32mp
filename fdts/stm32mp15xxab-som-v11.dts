// SPDX-License-Identifier: (GPL-2.0+ OR BSD-3-Clause)
/*
 * Copyright (C) STMicroelectronics 2019 - All Rights Reserved
 * Author: Alexandre Torgue <alexandre.torgue@st.com> for STMicroelectronics.
 */

/dts-v1/;

#include "stm32mp157.dtsi"
#include "stm32mp15xa.dtsi"
#include "stm32mp15-pinctrl.dtsi"
#include "stm32mp15xxab-pinctrl.dtsi"
#include "stm32mp15xxab-som-v11-pin.dtsi"
#include "stm32mp15xxab-som-v11.dtsi"

/ {
	model = "OneKiwi STM32MP15xxAB SOM v1.1 (STM32MP157AAB)";
	compatible = "st,stm32mp15xxab-som-v11", "st,stm32mp157";

	aliases {
		serial0 = &uart4;
	};

	chosen {
		stdout-path = "serial0:115200n8";
	};
};
